## drivers/gpu/drm/glamo/Kconfig
```kconfig
config DRM_GLAMO
	tristate "Glamo direct rendering and kernel modesetting support with DRM"
	depends on MFD_GLAMO && DRM
	select FB_CFB_FILLRECT
	select FB_CFB_COPYAREA
	select FB_CFB_IMAGEBLIT
	select DRM_KMS_HELPER
	help
	  Direct Rendering Manager interface for the S-Media Glamo chip, as
	  used in Openmoko FreeRunner (GTA02).

	  This DRM driver includes kernel modesetting (KMS) support.  As such,
	  do not select MFD_GLAMO_FB above if you choose to enable this option.

	  If unsure, say N.
```
